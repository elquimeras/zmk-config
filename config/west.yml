## config/west.yml
```yaml
manifest:
  remotes:
    - name: zmkfirmware
      url-base: https://github.com/elquimeras
  projects:
    - name: zmk
      remote: zmkfirmware
      revision: feature/bt-host-profile-select-v0.3
      import: app/west.yml
  self:
    path: config
```
